## meta-custom-rust/conf/layer.conf
```bitbake
# We have a conf and classes directory, add to BBPATH
BBPATH .= ":${LAYERDIR}"

# We have recipes-* directories, add to BBFILES
BBFILES += "${LAYERDIR}/recipes-*/*/*.bb \
            ${LAYERDIR}/recipes-*/*/*.bbappend"

BBFILE_COLLECTIONS += "meta-custom-rust"
BBFILE_PATTERN_meta-custom-rust = "^${LAYERDIR}/"
BBFILE_PRIORITY_meta-custom-rust = "6"

LAYERDEPENDS_meta-custom-rust = "core"
LAYERSERIES_COMPAT_meta-custom-rust = "scarthgap mickledore"
```
